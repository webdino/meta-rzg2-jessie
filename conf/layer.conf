## conf/layer.conf
```bitbake
# We have a conf and classes directory, add to BBPATH
BBPATH .= ":${LAYERDIR}"

# We have recipes-* directories, add to BBFILES
BBFILES += "${LAYERDIR}/recipes-*/*/*.bb \
            ${LAYERDIR}/recipes-*/*/*.bbappend"

BBFILE_COLLECTIONS += "meta-rzg2-jessie"
BBFILE_PATTERN_meta-rzg2-jessie = "^${LAYERDIR}/"
BBFILE_PRIORITY_meta-rzg2-jessie = "7"
```
